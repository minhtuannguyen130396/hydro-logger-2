## sdkconfig.defaults
```kconfig
# Minimal defaults. Adjust to your board & needs.
CONFIG_FREERTOS_HZ=100
CONFIG_ESP_TASK_WDT=y
CONFIG_ESP_TASK_WDT_TIMEOUT_S=10

# Enable NVS and HTTP client commonly used
CONFIG_NVS_ENCRYPTION=n
CONFIG_ESP_HTTP_CLIENT_ENABLE_HTTPS=y
CONFIG_ESP_HTTP_CLIENT_ENABLE_BASIC_AUTH=y

# OTA: enable rollback (anti-brick) and allow plain-HTTP firmware URLs.
CONFIG_BOOTLOADER_APP_ROLLBACK_ENABLE=y
CONFIG_ESP_HTTPS_OTA_ALLOW_HTTP=y

# If you use light sleep / deep sleep later:
# CONFIG_PM_ENABLE=y

# Custom partition table
CONFIG_PARTITION_TABLE_CUSTOM=y
CONFIG_PARTITION_TABLE_CUSTOM_FILENAME="partitions.csv"
CONFIG_PARTITION_TABLE_FILENAME="partitions.csv"
CONFIG_PARTITION_TABLE_OFFSET=0x8000

# Flash size config (4MB required by partitions.csv)
CONFIG_ESPTOOLPY_FLASHSIZE_4MB=y
CONFIG_ESPTOOLPY_FLASHSIZE="4MB"
```
